## boards/shields/td34/Kconfig.defconfig
```kconfig
if SHIELD_TD34_LEFT

config ZMK_KEYBOARD_NAME
    default "TrongDong34"

config ZMK_SPLIT_ROLE_CENTRAL
    default y

endif

if SHIELD_TD34_LEFT || SHIELD_TD34_RIGHT

config ZMK_SPLIT
    default y

endif
```

## boards/shields/td34/Kconfig.shield
```kconfig
config SHIELD_TD34_LEFT
    def_bool $(shields_list_contains,td34_left)

config SHIELD_TD34_RIGHT
    def_bool $(shields_list_contains,td34_right)
```

## config/west.yml
```yaml
manifest:
  remotes:
    - name: zmkfirmware
      url-base: https://github.com/4nh3k
  projects:
    - name: zmk
      remote: zmkfirmware
      revision: main
      import: app/west.yml
  self:   
    path: config
```
